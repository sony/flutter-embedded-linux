## meta-flutter/conf/layer.conf
```bitbake
# We have a conf and classes directory, add to BBPATH
BBPATH .= ":${LAYERDIR}"

# We have recipes-* directories, add to BBFILES
BBFILES += "${LAYERDIR}/recipes-*/*/*.bb \
            ${LAYERDIR}/recipes-*/*/*.bbappend"

BBFILE_COLLECTIONS += "meta-flutter"
BBFILE_PATTERN_meta-flutter = "^${LAYERDIR}/"
BBFILE_PRIORITY_meta-flutter = "6"

LAYERDEPENDS_meta-flutter = "core"
```
